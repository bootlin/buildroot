## boot/trusted-firmware-m/Config.in
```kconfig
config BR2_TARGET_TRUSTED_FIRMWARE_M
	bool "TrustedFirmware-M (TF-M)"
	select BR2_TARGET_TFM_TESTS
	select BR2_TARGET_TFM_MBEDTLS
	select BR2_TARGET_TFM_MCUBOOT
	select BR2_TARGET_TFM_QCBOR
	select BR2_TARGET_TFM_CMSIS
	select BR2_HOST_CMAKE_AT_LEAST_3_21
	help
	  Enable this option if you want to build the TF-M for your
	  ARMv8 microcontroller.

	  https://git.trustedfirmware.org/TF-M/trusted-firmware-m.git

if BR2_TARGET_TRUSTED_FIRMWARE_M
choice
	prompt "TF-M Version"
	help
	  Select the specific TF-M version you want to use

config BR2_TARGET_TRUSTED_FIRMWARE_M_LATEST_VERSION
	bool "TF-Mv2.1.0"

config BR2_TARGET_TRUSTED_FIRMWARE_M_CUSTOM_VERSION
	bool "Custom version"
	select BR2_TARGET_TRUSTED_FIRMWARE_M_CUSTOM_3RD_PARTY
	help
	  This option allows to use a specific official versions

config BR2_TARGET_TRUSTED_FIRMWARE_M_CUSTOM_TARBALL
	bool "Custom tarball"
	select BR2_TARGET_TRUSTED_FIRMWARE_M_CUSTOM_3RD_PARTY

config BR2_TARGET_TRUSTED_FIRMWARE_M_CUSTOM_GIT
	bool "Custom Git repository"
	select BR2_TARGET_TRUSTED_FIRMWARE_M_CUSTOM_3RD_PARTY

endchoice

if BR2_TARGET_TRUSTED_FIRMWARE_M_CUSTOM_TARBALL

config BR2_TARGET_TRUSTED_FIRMWARE_M_CUSTOM_TARBALL_LOCATION
	string "URL of custom TF-M tarball"

endif

config BR2_TARGET_TRUSTED_FIRMWARE_M_CUSTOM_VERSION_VALUE
	string "TF-M version"
	depends on BR2_TARGET_TRUSTED_FIRMWARE_M_CUSTOM_VERSION

config BR2_TARGET_TRUSTED_FIRMWARE_M_VERSION
	string
	default "0c4c99ba33b3e66deea070e149279278dc7647f4" \
				if BR2_TARGET_TRUSTED_FIRMWARE_M_LATEST_VERSION
	default "custom"	if BR2_TARGET_TRUSTED_FIRMWARE_M_CUSTOM_TARBALL
	default BR2_TARGET_TRUSTED_FIRMWARE_M_CUSTOM_REPO_VERSION \
				if BR2_TARGET_TRUSTED_FIRMWARE_M_CUSTOM_GIT
	default BR2_TARGET_TRUSTED_FIRMWARE_M_CUSTOM_VERSION_VALUE \
				if BR2_TARGET_TRUSTED_FIRMWARE_M_CUSTOM_VERSION

if BR2_TARGET_TRUSTED_FIRMWARE_M_CUSTOM_GIT

config BR2_TARGET_TRUSTED_FIRMWARE_M_CUSTOM_REPO_URL
	string "URL of custom repository"

config BR2_TARGET_TRUSTED_FIRMWARE_M_CUSTOM_REPO_VERSION
	string "Custom repository version"
	help
	  Revision to use in the typical format used by Git
	  E.G. a sha id, a tag, ..

endif

menu "TF-M 3rd party projects"
config BR2_TARGET_TRUSTED_FIRMWARE_M_CUSTOM_3RD_PARTY
	bool "Use custom tarball for TF-M 3rd party projects"

source "boot/trusted-firmware-m/tfm-mbedtls/Config.in"
source "boot/trusted-firmware-m/tfm-mcuboot/Config.in"
source "boot/trusted-firmware-m/tfm-qcbor/Config.in"
source "boot/trusted-firmware-m/tfm-cmsis/Config.in"
source "boot/trusted-firmware-m/tfm-tests/Config.in"

endmenu

config BR2_TARGET_TRUSTED_FIRMWARE_M_PLATFORM
	string "TF-M platform path"
	help
	  Target plaform path to build for.

config BR2_TARGET_TRUSTED_FIRMWARE_M_ADDITIONAL_VARIABLES
	string "Additional TF-M build variables"
	help
	  Additional parameters for the TF-M build
	  E.G. '-DTFM_ISOLATION_LEVEL=2 -DTFM_PROFILE=large'

config BR2_TARGET_TRUSTED_FIRMWARE_M_DEBUG
	bool "Build in debug mode"
	help
	  Enable this option to build TF-M with -DCMAKE_BUILD_TYPE=Debug.

endif
```

## boot/trusted-firmware-m/tfm-cmsis/Config.in
```kconfig
config BR2_TARGET_TFM_CMSIS
	bool

if BR2_TARGET_TRUSTED_FIRMWARE_M_CUSTOM_3RD_PARTY

config BR2_TARGET_TFM_CMSIS_CUSTOM_TARBALL_LOCATION
	string "URL of custom cmcis tarball"
	default "$(call github,arm-software,cmsis_6)/d0c460c169.tar.gz"

endif
```

## boot/trusted-firmware-m/tfm-mbedtls/Config.in
```kconfig
config BR2_TARGET_TFM_MBEDTLS
	bool

if BR2_TARGET_TRUSTED_FIRMWARE_M_CUSTOM_3RD_PARTY

config BR2_TARGET_TFM_MBEDTLS_CUSTOM_TARBALL_LOCATION
	string "URL of custom mbedtls tarball"
	default "https://github.com/Mbed-TLS/mbedtls/releases/download/v3.6.0/mbedtls-3.6.0.tar.bz2"

endif
```

## boot/trusted-firmware-m/tfm-mcuboot/Config.in
```kconfig
config BR2_TARGET_TFM_MCUBOOT
	bool

if BR2_TARGET_TRUSTED_FIRMWARE_M_CUSTOM_3RD_PARTY

config BR2_TARGET_TFM_MCUBOOT_CUSTOM_TARBALL_LOCATION
	string "URL of custom mcuboot tarball"
	default "$(call github,mcu-tools,mcuboot)/v2.1.0.tar.gz"

endif
```

## boot/trusted-firmware-m/tfm-qcbor/Config.in
```kconfig
config BR2_TARGET_TFM_QCBOR
	bool

if BR2_TARGET_TRUSTED_FIRMWARE_M_CUSTOM_3RD_PARTY

config BR2_TARGET_TFM_QCBOR_CUSTOM_TARBALL_LOCATION
	string "URL of custom qcbor tarball"
	default "$(call github,laurencelundblade,qcbor)/v1.2.tar.gz"

endif
```

## boot/trusted-firmware-m/tfm-tests/Config.in
```kconfig
config BR2_TARGET_TFM_TESTS
	bool

if BR2_TARGET_TRUSTED_FIRMWARE_M_CUSTOM_3RD_PARTY

config BR2_TARGET_TFM_TESTS_CUSTOM_TARBALL_LOCATION
	string "URL of custom TF-M-tests tarball"
	default "https://git.trustedfirmware.org/TF-M/tf-m-tests.git/+archive/TF-Mv2.1.0.tar.gz"

endif
```

## configs/pine64_debugging_defconfig
```kconfig
BR2_aarch64=y
BR2_ARM_FPU_VFPV4=y
BR2_TOOLCHAIN_EXTERNAL=y
BR2_TOOLCHAIN_EXTERNAL_GDB_SERVER_COPY=y
BR2_TARGET_GENERIC_ISSUE="Welcome to PINE64"
BR2_TARGET_GENERIC_ROOT_PASSWD="root"
BR2_ROOTFS_OVERLAY="board/pine64/pine64-debugging/overlay/"
BR2_ROOTFS_POST_IMAGE_SCRIPT="board/pine64/pine64-debugging/post-image.sh"
BR2_ROOTFS_POST_SCRIPT_ARGS="-c board/pine64/pine64/genimage.cfg"
BR2_LINUX_KERNEL=y
BR2_LINUX_KERNEL_CUSTOM_VERSION=y
BR2_LINUX_KERNEL_CUSTOM_VERSION_VALUE="5.0"
BR2_LINUX_KERNEL_USE_CUSTOM_CONFIG=y
BR2_LINUX_KERNEL_CUSTOM_CONFIG_FILE="board/pine64/pine64-debugging/linux.config"
BR2_LINUX_KERNEL_DTS_SUPPORT=y
BR2_LINUX_KERNEL_INTREE_DTS_NAME="allwinner/sun50i-a64-pine64"
BR2_LINUX_KERNEL_INSTALL_TARGET=y
BR2_LINUX_KERNEL_NEEDS_HOST_OPENSSL=y
BR2_PACKAGE_LINUX_TOOLS_PERF=y
BR2_PACKAGE_LINUX_TOOLS_PERF_SCRIPTS=y
BR2_PACKAGE_LINUX_TOOLS_PERF_TUI=y
BR2_PACKAGE_BUSYBOX_SHOW_OTHERS=y
BR2_PACKAGE_DEBUGGING_TRAINING=y
BR2_PACKAGE_DEBUGGING_PINE64=y
BR2_PACKAGE_GDB=y
BR2_PACKAGE_KEXEC=y
BR2_PACKAGE_KEXEC_ZLIB=y
BR2_PACKAGE_LTRACE=y
BR2_PACKAGE_LTTNG_MODULES=y
BR2_PACKAGE_LTTNG_TOOLS=y
BR2_PACKAGE_MEMSTAT=y
BR2_PACKAGE_PV=y
BR2_PACKAGE_STRACE=y
BR2_PACKAGE_STRESS_NG=y
BR2_PACKAGE_TRACE_CMD=y
BR2_PACKAGE_VALGRIND=y
BR2_PACKAGE_SYSSTAT=y
BR2_PACKAGE_PERL=y
BR2_PACKAGE_PYTHON3=y
BR2_PACKAGE_LIBPNG=y
BR2_PACKAGE_LTTNG_LIBUST=y
BR2_PACKAGE_DROPBEAR=y
BR2_PACKAGE_IFTOP=y
BR2_PACKAGE_IPERF3=y
BR2_PACKAGE_IOTOP=y
BR2_PACKAGE_PROCPS_NG=y
BR2_TARGET_ROOTFS_EXT2=y
BR2_TARGET_ROOTFS_EXT2_4=y
BR2_TARGET_ARM_TRUSTED_FIRMWARE=y
BR2_TARGET_ARM_TRUSTED_FIRMWARE_CUSTOM_GIT=y
BR2_TARGET_ARM_TRUSTED_FIRMWARE_CUSTOM_REPO_URL="https://github.com/apritzel/arm-trusted-firmware.git"
BR2_TARGET_ARM_TRUSTED_FIRMWARE_CUSTOM_REPO_VERSION="aa75c8da415158a94b82a430b2b40000778e851f"
BR2_TARGET_ARM_TRUSTED_FIRMWARE_PLATFORM="sun50iw1p1"
BR2_TARGET_UBOOT=y
BR2_TARGET_UBOOT_BUILD_SYSTEM_KCONFIG=y
BR2_TARGET_UBOOT_CUSTOM_VERSION=y
BR2_TARGET_UBOOT_CUSTOM_VERSION_VALUE="2019.01"
BR2_TARGET_UBOOT_USE_CUSTOM_CONFIG=y
BR2_TARGET_UBOOT_CUSTOM_CONFIG_FILE="board/pine64/pine64-debugging/uboot.config"
BR2_TARGET_UBOOT_NEEDS_DTC=y
BR2_TARGET_UBOOT_NEEDS_PYLIBFDT=y
BR2_TARGET_UBOOT_NEEDS_OPENSSL=y
BR2_TARGET_UBOOT_NEEDS_ATF_BL31=y
BR2_TARGET_UBOOT_FORMAT_CUSTOM=y
BR2_TARGET_UBOOT_FORMAT_CUSTOM_NAME="u-boot.itb"
BR2_TARGET_UBOOT_SPL=y
BR2_TARGET_UBOOT_SPL_NAME="spl/sunxi-spl.bin"
BR2_TARGET_UBOOT_CUSTOM_MAKEOPTS="DEVICE_TREE=sun50i-a64-pine64-plus"
BR2_PACKAGE_HOST_DOSFSTOOLS=y
BR2_PACKAGE_HOST_GENIMAGE=y
BR2_PACKAGE_HOST_MTOOLS=y
BR2_PACKAGE_HOST_UBOOT_TOOLS=y
BR2_PACKAGE_HOST_UBOOT_TOOLS_ENVIMAGE=y
BR2_PACKAGE_HOST_UBOOT_TOOLS_ENVIMAGE_SOURCE="board/pine64/pine64-debugging/uboot-env.txt"
BR2_PACKAGE_HOST_UBOOT_TOOLS_ENVIMAGE_SIZE="32768"
BR2_PACKAGE_HOST_UBOOT_TOOLS_BOOT_SCRIPT=y
BR2_PACKAGE_HOST_UBOOT_TOOLS_BOOT_SCRIPT_SOURCE="board/pine64/pine64/boot.cmd"
```

## configs/qemu_x86_BIOS_EFI_defconfig
```kconfig
BR2_x86_pentiumpro=y
BR2_PACKAGE_HOST_LINUX_HEADERS_CUSTOM_5_10=y
BR2_TOOLCHAIN_BUILDROOT_WCHAR=y
BR2_SYSTEM_DHCP="eth0"
BR2_ROOTFS_POST_BUILD_SCRIPT="board/qemu/x86/post-build.sh"
BR2_LINUX_KERNEL=y
BR2_LINUX_KERNEL_CUSTOM_VERSION=y
BR2_LINUX_KERNEL_CUSTOM_VERSION_VALUE="5.10.7"
BR2_LINUX_KERNEL_USE_CUSTOM_CONFIG=y
BR2_LINUX_KERNEL_CUSTOM_CONFIG_FILE="board/qemu/x86/linux.config"
BR2_LINUX_KERNEL_INSTALL_TARGET=y
BR2_TARGET_ROOTFS_ISO9660=y
BR2_TARGET_ROOTFS_ISO9660_BOOT_MENU="fs/iso9660/grub.cfg"
# BR2_TARGET_ROOTFS_TAR is not set
BR2_TARGET_GRUB2=y
BR2_TARGET_GRUB2_I386_PC=y
BR2_TARGET_GRUB2_I386_EFI=y
BR2_TARGET_GRUB2_BOOT_PARTITION="cd"
BR2_TARGET_GRUB2_BUILTIN_MODULES_PC="boot linux ext2 fat squash4 part_msdos part_gpt normal iso9660 biosdisk"
BR2_TARGET_GRUB2_BUILTIN_MODULES_EFI="boot linux ext2 fat squash4 part_msdos part_gpt normal iso9660 efi_gop"
BR2_TARGET_GRUB2_BUILTIN_CONFIG_EFI="board/qemu/x86/efi.cfg"
BR2_PACKAGE_HOST_QEMU=y
BR2_PACKAGE_HOST_QEMU_SYSTEM_MODE=y
```

## configs/stm32mp157a_dk1_debugging_defconfig
```kconfig
BR2_arm=y
BR2_cortex_a7=y
BR2_TOOLCHAIN_EXTERNAL=y
BR2_TOOLCHAIN_EXTERNAL_BOOTLIN=y
BR2_TOOLCHAIN_EXTERNAL_GDB_SERVER_COPY=y
BR2_ENABLE_DEBUG=y
# BR2_STRIP_strip is not set
BR2_GLOBAL_PATCH_DIR="board/stmicroelectronics/stm32mp157a-dk1-debugging/patches/"
BR2_TARGET_GENERIC_ROOT_PASSWD="root"
BR2_ROOTFS_OVERLAY="board/stmicroelectronics/stm32mp157a-dk1-debugging/overlay/"
BR2_ROOTFS_POST_IMAGE_SCRIPT="board/stmicroelectronics/stm32mp157a-dk1-debugging/post-image.sh"
BR2_LINUX_KERNEL=y
BR2_LINUX_KERNEL_CUSTOM_VERSION=y
BR2_LINUX_KERNEL_CUSTOM_VERSION_VALUE="5.13"
BR2_LINUX_KERNEL_USE_CUSTOM_CONFIG=y
BR2_LINUX_KERNEL_CUSTOM_CONFIG_FILE="board/stmicroelectronics/stm32mp157a-dk1-debugging/linux.config"
BR2_LINUX_KERNEL_DTS_SUPPORT=y
BR2_LINUX_KERNEL_INTREE_DTS_NAME="stm32mp157a-dk1"
BR2_LINUX_KERNEL_INSTALL_TARGET=y
BR2_PACKAGE_LINUX_TOOLS_PERF=y
BR2_PACKAGE_LINUX_TOOLS_PERF_SCRIPTS=y
BR2_PACKAGE_LINUX_TOOLS_PERF_TUI=y
BR2_PACKAGE_BUSYBOX_SHOW_OTHERS=y
BR2_PACKAGE_DEBUGGING_TRAINING=y
BR2_PACKAGE_KEXEC=y
BR2_PACKAGE_KEXEC_ZLIB=y
BR2_PACKAGE_LTRACE=y
BR2_PACKAGE_LTTNG_MODULES=y
BR2_PACKAGE_LTTNG_TOOLS=y
BR2_PACKAGE_MEMSTAT=y
BR2_PACKAGE_PV=y
BR2_PACKAGE_STRACE=y
BR2_PACKAGE_STRESS_NG=y
BR2_PACKAGE_TRACE_CMD=y
BR2_PACKAGE_VALGRIND=y
BR2_PACKAGE_SYSSTAT=y
BR2_PACKAGE_PERL=y
BR2_PACKAGE_PYTHON3=y
BR2_PACKAGE_LIBPNG=y
BR2_PACKAGE_LTTNG_LIBUST=y
BR2_PACKAGE_DROPBEAR=y
BR2_PACKAGE_IFTOP=y
BR2_PACKAGE_IPERF3=y
BR2_PACKAGE_COREUTILS=y
BR2_PACKAGE_IOTOP=y
BR2_PACKAGE_PROCPS_NG=y
BR2_TARGET_ARM_TRUSTED_FIRMWARE=y
BR2_TARGET_ARM_TRUSTED_FIRMWARE_CUSTOM_VERSION=y
BR2_TARGET_ARM_TRUSTED_FIRMWARE_CUSTOM_VERSION_VALUE="v2.5"
BR2_TARGET_ARM_TRUSTED_FIRMWARE_PLATFORM="stm32mp1"
BR2_TARGET_ARM_TRUSTED_FIRMWARE_ADDITIONAL_VARIABLES="STM32MP_SDMMC=1 AARCH32_SP=sp_min DTB_FILE_NAME=stm32mp157a-dk1.dtb"
BR2_TARGET_ARM_TRUSTED_FIRMWARE_IMAGES="*.stm32"
BR2_TARGET_ARM_TRUSTED_FIRMWARE_NEEDS_DTC=y
BR2_TARGET_UBOOT=y
BR2_TARGET_UBOOT_BUILD_SYSTEM_KCONFIG=y
BR2_TARGET_UBOOT_CUSTOM_VERSION=y
BR2_TARGET_UBOOT_CUSTOM_VERSION_VALUE="2021.10"
BR2_TARGET_UBOOT_USE_CUSTOM_CONFIG=y
BR2_TARGET_UBOOT_CUSTOM_CONFIG_FILE="board/stmicroelectronics/stm32mp157a-dk1-debugging/uboot.config"
BR2_TARGET_UBOOT_NEEDS_OPENSSL=y
# BR2_TARGET_UBOOT_FORMAT_BIN is not set
BR2_TARGET_UBOOT_FORMAT_STM32=y
BR2_TARGET_UBOOT_CUSTOM_MAKEOPTS="DEVICE_TREE=stm32mp157a-dk1"
BR2_PACKAGE_HOST_E2FSPROGS=y
BR2_PACKAGE_HOST_GENEXT2FS=y
BR2_PACKAGE_HOST_GENIMAGE=y
BR2_PACKAGE_HOST_UBOOT_TOOLS=y
BR2_PACKAGE_HOST_UBOOT_TOOLS_ENVIMAGE=y
BR2_PACKAGE_HOST_UBOOT_TOOLS_ENVIMAGE_SOURCE="board/stmicroelectronics/stm32mp157a-dk1-debugging/uboot-env.txt"
BR2_PACKAGE_HOST_UBOOT_TOOLS_ENVIMAGE_SIZE="32768"
```

## configs/stm32mp157a_dk1_debugging_kexec_defconfig
```kconfig
BR2_arm=y
BR2_cortex_a7=y
BR2_TOOLCHAIN_EXTERNAL=y
BR2_TOOLCHAIN_EXTERNAL_BOOTLIN=y
BR2_TOOLCHAIN_EXTERNAL_BOOTLIN_ARMV7_EABIHF_GLIBC_STABLE=y
BR2_PER_PACKAGE_DIRECTORIES=y
BR2_TARGET_GENERIC_ROOT_PASSWD="root"
BR2_ROOTFS_OVERLAY="board/stmicroelectronics/stm32mp157a-dk1-debugging/overlay_kexec/"
BR2_LINUX_KERNEL=y
BR2_LINUX_KERNEL_CUSTOM_VERSION=y
BR2_LINUX_KERNEL_CUSTOM_VERSION_VALUE="5.13"
BR2_LINUX_KERNEL_USE_CUSTOM_CONFIG=y
BR2_LINUX_KERNEL_CUSTOM_CONFIG_FILE="board/stmicroelectronics/stm32mp157a-dk1-debugging/linux_kexec.config"
BR2_LINUX_KERNEL_DTS_SUPPORT=y
BR2_LINUX_KERNEL_INTREE_DTS_NAME="stm32mp157a-dk1"
BR2_PACKAGE_OPENSSH=y
BR2_TARGET_ROOTFS_CPIO_GZIP=y
BR2_TARGET_ROOTFS_INITRAMFS=y
# BR2_TARGET_ROOTFS_TAR is not set
BR2_PACKAGE_HOST_DTC=y
BR2_PACKAGE_HOST_E2FSPROGS=y
BR2_PACKAGE_HOST_GENIMAGE=y
```

## package/debugging-pine64/Config.in
```kconfig
config BR2_PACKAGE_DEBUGGING_PINE64
	bool "debugging pine64"
	help
	  Miscellaneous utilities specific to the bootlin debugging training on Pine64

	  https://bootlin.com/training/debugging/
```

## package/debugging-training/Config.in
```kconfig
config BR2_PACKAGE_DEBUGGING_TRAINING
	bool "debugging training"
	help
	  Miscellaneous utilities specific to the bootlin debugging training

	  https://bootlin.com/training/debugging/
```

## package/edk2-images/Config.in.host
```kconfig
config BR2_PACKAGE_HOST_EDK2_IMAGES
	bool "host EFI BIOS binaries"
	help
	  Downloads and installs pre-compiled EDK2 EFI BIOS images.
	  They are typically useful to allow Qemu to emulate an x86 or
	  x86-64 system with an EFI-compliant BIOS.

	  https://www.kraxel.org/repos/jenkins/edk2/

if BR2_PACKAGE_HOST_EDK2_IMAGES

choice
	prompt "EFI Architecture"
	default BR2_PACKAGE_HOST_EDK2_IMAGES_IA32
	help
	  select the desired architecture

config BR2_PACKAGE_HOST_EDK2_IMAGES_IA32
	bool "ia32"

config BR2_PACKAGE_HOST_EDK2_IMAGES_X64
	bool "x64"

endchoice

endif
```
